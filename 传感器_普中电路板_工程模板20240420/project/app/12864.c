//基于ST7920的12864液晶显示
#include <ST7920.h>
#define DATA P0		 //数据输入输出端口 
#define delayNOP(); {_nop_();_nop_();_nop_();_nop_();};	   //延时4us
u8 row=0; //当前光标所在位置行坐标 
u8 col=0; //当前光标所在位置列坐标 

/*12864ST7920端口定义*/
sbit LCD_RS  =  P3^4;            //寄存器选择输入 
sbit LCD_RW  =  P3^5;            //液晶读/写控制
sbit LCD_EN  =  P3^6;            //液晶使能控制
sbit LCD_PSB =  P3^7;            //串/并方式控制
 		
/*******************************************************************/
/*检查LCD忙状态                                                    */
/*lcd_busy为1时，忙，等待。lcd-busy为0时,闲，可写指令与数据。      */
/*******************************************************************/
bit lcd_busy()
 {                          
    bit result;
    LCD_RS = 0;
    LCD_RW = 1;
    LCD_EN = 1;
    delayNOP();	 //延时4us
    result = (bit)(DATA&0x80);
    LCD_EN = 0;
    return(result); 
 }
/*******************************************************************/
/*写指令数据到LCD                                                  */
/*RS=L，RW=L，E=高脉冲，D0-D7=指令码。                             */
/*******************************************************************/
void lcd_wcmd(u8 cmd)
{                          
    while(lcd_busy());
    LCD_RS = 0;
    LCD_RW = 0;
    LCD_EN = 0;
    _nop_();
    _nop_(); 
    DATA = cmd;
    delayNOP();
    LCD_EN = 1;
    delayNOP();
    LCD_EN = 0;  
}
/*******************************************************************/
/*写显示数据到LCD                                                  */
/*RS=H，RW=L，E=高脉冲，D0-D7=数据。                               */
/*******************************************************************/
void lcd_wdat(u8 dat)
{                          
    while(lcd_busy());
    LCD_RS = 1;
    LCD_RW = 0;
    LCD_EN = 0;
    DATA = dat;
    delayNOP();
    LCD_EN = 1;
    delayNOP();
    LCD_EN = 0; 
}
/*******************************************************************/
/*  LCD初始化设定                                                  */
/*******************************************************************/
void ST7920_Init() //初始化函数
{ 

    LCD_PSB = 1;         //并口方式
    
//  lcd_wcmd(0x34);      //扩充指令操作
//  delay_ms(5);
    lcd_wcmd(0x30);      //基本指令操作
    delay_ms(5);
    lcd_wcmd(0x0c);      //显示开，关光标
	delay_ms(5);
    lcd_wcmd(0x01);      //清除LCD的显示内容
    delay_ms(5);
}
/*********************************************************/
/* 设定显示位置                                          */
/*********************************************************/
void ST7920_pos(u8 X,u8 Y) //设置显示坐标,X行坐标(0-3),Y列坐标(0-7)
{                          
   u8  pos,a;
   row=X;
   col=Y;
   if (X==0)
     {a=0x80;}
   else if (X==1)
     {a=0x90;}
   else if (X==2)
     {a=0x88;}
   else if (X==3)
     {a=0x98;}
   pos = a+Y ;  
   lcd_wcmd(pos);     //显示地址
}
/*********************************************************/
/* 显示汉字串函数           			  				 */
/*********************************************************/
void ST7920_str(u8 *p,u8 x,u8 y)//从指定位置开始显示汉字串（字数不超过32）
 {
    u8 i;
    ST7920_pos(x,y); //设置起始坐标       
    i = 0;
    while(p[i]!= '\0')
     {                         //显示字符
       lcd_wdat(p[i]);
       i++;
	   lcd_wdat(p[i]);
       i++;
	   col++;
	   if(col%8==0) {row++; row=row%4; col=0; ST7920_pos(row,col);}//写满一行时就跳到下一行；一个汉字占2个字节
 
     }		   
}
 
void ST7920_Clear()//清屏函数
{ 
    lcd_wcmd(0x01);      //清除LCD的显示内容
    delay_ms(5);
	ST7920_pos(0,0);     //坐标返回到首行首位
}
void ST7920_Picture(u8 *pPicture) //显示画图，分辨率128*64，图片点阵阴码、高位在前、逐行
{	
	u8 i, j ;
	lcd_wcmd(0x34);        //写数据时，选择扩充指令，关闭图形显示
	/* ==== 先操作上半屏 ==== */
	for(i = 0;i < 32;i++)         //i用来控制垂直地址Y（0~31）
	{   
	    for(j = 0;j < 8;j++)   	//一行共8个“水平列”，1个“水平列”数据需分两次写，    
	    {	
			lcd_wcmd(0x80 + i);  	//先写垂直坐标值
			lcd_wcmd(0x80 + j);  	//再写水平坐标值，上半屏水平地址X是(0-7)
	                            	//每写入一“水平列”数据(16位)后水平地址自动增加1
			lcd_wdat(*pPicture++);  //先高8位
			lcd_wdat(*pPicture++);  //后低8位   
		}	
	}
	/* ==== 后操作下半屏 ==== */
	for(i = 0;i < 32;i++)
	{   
	    for(j = 0;j < 8;j++)   	    
	    {	
			lcd_wcmd(0x80 + i);  	
			lcd_wcmd(0x80 + 8 + j); //下半屏水平地址X是(8-15)
	                            	
			lcd_wdat(*pPicture++);  
			lcd_wdat(*pPicture++);     
		}	
	}
	lcd_wcmd(0x36);  //写完数据,开图形显示 
}

void num_hs_to_fs(u8 *half_str,u8 *full_str)//将半角字符串转换成全角字符串
{
	u8 i,j;
	i=0; 
	j=0;
	while(half_str[i])
	{
	 full_str[j++]=0xA3;
	 full_str[j++]=0x80+half_str[i++];	
	}
	full_str[j]='\0';
}  